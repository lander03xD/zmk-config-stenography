## boards/shields/green-fluke/Kconfig.shield
```kconfig
# No whitespace after the comma or in your part name!
config SHIELD_GREEN_FLUKE_LEFT
    def_bool $(shields_list_contains,green_fluke_left)

# No whitespace after the comma or in your part name!
config SHIELD_GREEN_FLUKE_RIGHT
    def_bool $(shields_list_contains,green_fluke_right)
```

## boards/shields/green_fluke/Kconfig.defconfig
```kconfig
config CONFIG_ZMK_HID_REPORT_TYPE_HKRO 
    default y
    
config CONFIG_ZMK_HID_KEYBOARD_REPORT_SIZE
    default 12


if SHIELD_GREEN_FLUKE_LEFT

# Name must be less than 16 characters long!
config ZMK_KEYBOARD_NAME
    default "greenFluke"

config ZMK_SPLIT_ROLE_CENTRAL
    default y

endif

if SHIELD_GREEN_FLUKE_LEFT || SHIELD_GREEN_FLUKE_RIGHT

config ZMK_SPLIT
    default y

endif
```
